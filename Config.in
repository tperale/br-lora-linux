## Config.in
```kconfig
menu "LoRa"
    source "$BR2_EXTERNAL_LINUX_LORA_PATH/package/lora-tx/Config.in"
endmenu
```

## configs/beaglebone_lora_defconfig
```kconfig
# Architecture
BR2_arm=y
BR2_cortex_a8=y
BR2_ARM_FPU_VFPV3=y

BR2_PACKAGE_HOST_LINUX_HEADERS_CUSTOM_5_0=y

# System
BR2_ROOTFS_DEVICE_CREATION_DYNAMIC_MDEV=y
BR2_ROOTFS_OVERLAY="$(BR2_EXTERNAL_LINUX_LORA_PATH)/board/beaglebone/overlay/"

# Image
BR2_ROOTFS_POST_BUILD_SCRIPT="board/beaglebone/post-build.sh"
BR2_ROOTFS_POST_IMAGE_SCRIPT="support/scripts/genimage.sh"
BR2_ROOTFS_POST_SCRIPT_ARGS="-c $(BR2_EXTERNAL_LINUX_LORA_PATH)/board/beaglebone/genimage.cfg"

BR2_PACKAGE_OVERRIDE_FILE="$(BR2_EXTERNAL_LINUX_LORA_PATH)/local.mk"
BR2_GLOBAL_PATCH_DIR="$(BR2_EXTERNAL_LINUX_LORA_PATH)/board/beaglebone/patches"

# Kernel
BR2_KERNEL_HEADERS_AS_KERNEL=y
BR2_LINUX_KERNEL=y
BR2_LINUX_KERNEL_DEFCONFIG="omap2plus"
BR2_LINUX_KERNEL_CUSTOM_VERSION=y
BR2_LINUX_KERNEL_CUSTOM_VERSION_VALUE="5.0.21"
BR2_LINUX_KERNEL_DTS_SUPPORT=y
BR2_LINUX_KERNEL_CUSTOM_DTS_PATH="$(BR2_EXTERNAL_LINUX_LORA_PATH)/board/beaglebone/am335x-boneblack.dts"
BR2_LINUX_KERNEL_NEEDS_HOST_OPENSSL=y
BR2_LINUX_KERNEL_CONFIG_FRAGMENT_FILES="$(BR2_EXTERNAL_LINUX_LORA_PATH)/board/beaglebone/lora.fragment"

# Filesystem
BR2_TARGET_ROOTFS_EXT2=y
BR2_TARGET_ROOTFS_EXT2_4=y

# Bootloader
BR2_TARGET_UBOOT=y
BR2_TARGET_UBOOT_BUILD_SYSTEM_KCONFIG=y
BR2_TARGET_UBOOT_CUSTOM_VERSION=y
BR2_TARGET_UBOOT_CUSTOM_VERSION_VALUE="2023.10"
BR2_TARGET_UBOOT_BOARD_DEFCONFIG="am335x_evm"
BR2_TARGET_UBOOT_NEEDS_DTC=y
BR2_TARGET_UBOOT_NEEDS_OPENSSL=y
# BR2_TARGET_UBOOT_FORMAT_BIN is not set
BR2_TARGET_UBOOT_FORMAT_IMG=y
BR2_TARGET_UBOOT_SPL=y
BR2_TARGET_UBOOT_SPL_NAME="MLO"

# Required tools to create the SD image
BR2_PACKAGE_HOST_DOSFSTOOLS=y
BR2_PACKAGE_HOST_GENIMAGE=y
BR2_PACKAGE_HOST_MTOOLS=y

# Enable compressed kernel module support
BR2_PACKAGE_BUSYBOX_SHOW_OTHERS=y
BR2_PACKAGE_KMOD_TOOLS=y
BR2_PACKAGE_XZ=y
BR2_PACKAGE_KMOD=y
BR2_PACKAGE_HOST_KMOD_XZ=y

# Packages
BR2_PACKAGE_DROPBEAR=y
BR2_PACKAGE_DROPBEAR_CLIENT=y
BR2_PACKAGE_DROPBEAR_SMALL=y
BR2_PACKAGE_DROPBEAR_LOCALOPTIONS_FILE=""

# External

BR2_PACKAGE_LORA_TX=y
```

## package/lora-tx/Config.in
```kconfig
config BR2_PACKAGE_LORA_TX
    bool "LoRa TX"
    help
      Command line utility to send LoRa broadcast message with through the
      LoRa Linux network interface.
```
